## conf/layer.conf
```bitbake
# We have a conf and classes directory, add to BBPATH
BBPATH .= ":${LAYERDIR}"

# We have recipes-* directories, add to BBFILES
BBFILES += "${LAYERDIR}/recipes-*/*/*.bb \
            ${LAYERDIR}/recipes-*/*/*.bbappend"

BBFILE_COLLECTIONS += "meta-mm5d91-gui"
BBFILE_PATTERN_meta-mm5d91-gui = "^${LAYERDIR}/"
BBFILE_PRIORITY_meta-mm5d91-gui = "6"

LAYERDEPENDS_meta-mm5d91-gui = "core"
LAYERSERIES_COMPAT_meta-mm5d91-gui = "scarthgap styhead kirkstone"
```
